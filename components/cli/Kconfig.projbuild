## components/cli/Kconfig.projbuild
```kconfig
menu "CLI task"
    config CLI_PROMPT
        string "Prompt message"
        default ""

    config CLI_TASK_STACK_DEPTH
        int "Tasl stack depth"
        range 1024 65536
        default 4096

    config CLI_TASK_PRIORITY
        int "Task prioirty"
        range 0 20
        default 0

    config CLI_TASK_CPU
        int "Cpu which the task should be pinned to"
        range 0 1
        default 1
endmenu
```

## components/valves/Kconfig.projbuild
```kconfig
menu "Valves"
    config VALVES_TASK_STACK_DEPTH
        int "Task stack depth"
        range 1024 65536
        default 4096

    config VALVES_TASK_PRIORITY
        int "Task prioirty"
        range 0 20
        default 0

    config VALVES_TASK_CPU
        int "Cpu which the task should be pinned to"
        range 0 1
        default 0
endmenu
```

## sdkconfig.defaults
```kconfig
CONFIG_ESPTOOLPY_FLASHSIZE_4MB=y
CONFIG_ESPTOOLPY_FLASHSIZE="4MB"
CONFIG_FREERTOS_HZ=1000
CONFIG_INT_WDT_CHECK_CPU1=n
CONFIG_TASK_WDT_CHECK_IDLE_TASK_CPU1=n

CONFIG_CLI_TASK_CPU=0
```

## test/sdkconfig.defaults
```kconfig
CONFIG_ESP_TASK_WDT=n
CONFIG_COMPILER_OPTIMIZATION_ASSERTIONS_DISABLE=y

CONFIG_ESPTOOLPY_FLASHMODE="dio"
CONFIG_ESPTOOLPY_FLASHFREQ_40M=y
CONFIG_ESPTOOLPY_FLASHSIZE_4MB=y

CONFIG_BT_ENABLED=y
CONFIG_IDF_TARGET="esp32"

CONFIG_BT_BLE_50_FEATURES_SUPPORTED=n
CONFIG_BT_BLE_42_FEATURES_SUPPORTED=y
CONFIG_BT_LE_50_FEATURE_SUPPORT=n
```
